## CMakeLists.txt
```
# SPDX-License-Identifier: Apache-2.0

cmake_minimum_required(VERSION 3.20.0)
find_package(Zephyr REQUIRED HINTS $ENV{ZEPHYR_BASE})
project(nrf52840_nordic)
enable_language(C ASM)

target_sources(app PRIVATE
    src/main.c
    src/transport.c
    src/audio_queue.c
    src/stream_health.c
    src/diagnostics.c
    src/field_journal.c
    src/mic.c
    src/led.c
    src/audio.c
    src/codec.c
    src/lib/battery/battery.c
)

target_sources_ifdef(CONFIG_CODEC_OPUS app PRIVATE
    src/lib/opus-1.2.1/A2NLSF.c
    src/lib/opus-1.2.1/CNG.c
    src/lib/opus-1.2.1/HP_variable_cutoff.c
    src/lib/opus-1.2.1/LPC_analysis_filter.c
    src/lib/opus-1.2.1/LPC_fit.c
    src/lib/opus-1.2.1/LPC_inv_pred_gain.c
    src/lib/opus-1.2.1/LP_variable_cutoff.c
    src/lib/opus-1.2.1/LTP_analysis_filter_FIX.c
    src/lib/opus-1.2.1/LTP_scale_ctrl_FIX.c
    src/lib/opus-1.2.1/NLSF2A.c
    src/lib/opus-1.2.1/NLSF_VQ.c
    src/lib/opus-1.2.1/NLSF_VQ_weights_laroia.c
    src/lib/opus-1.2.1/NLSF_decode.c
    src/lib/opus-1.2.1/NLSF_del_dec_quant.c
    src/lib/opus-1.2.1/NLSF_encode.c
    src/lib/opus-1.2.1/NLSF_stabilize.c
    src/lib/opus-1.2.1/NLSF_unpack.c
    src/lib/opus-1.2.1/NSQ.c
    src/lib/opus-1.2.1/NSQ_del_dec.c
    src/lib/opus-1.2.1/PLC.c
    src/lib/opus-1.2.1/VAD.c
    src/lib/opus-1.2.1/VQ_WMat_EC.c
    src/lib/opus-1.2.1/ana_filt_bank_1.c
    src/lib/opus-1.2.1/analysis.c
    src/lib/opus-1.2.1/apply_sine_window_FIX.c
    src/lib/opus-1.2.1/autocorr_FIX.c
    src/lib/opus-1.2.1/bands.c
    src/lib/opus-1.2.1/biquad_alt.c
    src/lib/opus-1.2.1/burg_modified_FIX.c
    src/lib/opus-1.2.1/bwexpander.c
    src/lib/opus-1.2.1/bwexpander_32.c
    src/lib/opus-1.2.1/celt.c
    src/lib/opus-1.2.1/celt_decoder.c
    src/lib/opus-1.2.1/celt_encoder.c
    src/lib/opus-1.2.1/celt_lpc.c
    src/lib/opus-1.2.1/arm/celt_pitch_xcorr_arm_gcc.s
    src/lib/opus-1.2.1/check_control_input.c
    src/lib/opus-1.2.1/code_signs.c
    src/lib/opus-1.2.1/control_SNR.c
    src/lib/opus-1.2.1/control_audio_bandwidth.c
    src/lib/opus-1.2.1/control_codec.c
    src/lib/opus-1.2.1/corrMatrix_FIX.c
    src/lib/opus-1.2.1/cwrs.c
    src/lib/opus-1.2.1/debug.c
    src/lib/opus-1.2.1/dec_API.c
    src/lib/opus-1.2.1/decode_core.c
    src/lib/opus-1.2.1/decode_frame.c
    src/lib/opus-1.2.1/decode_indices.c
    src/lib/opus-1.2.1/decode_parameters.c
    src/lib/opus-1.2.1/decode_pitch.c
    src/lib/opus-1.2.1/decode_pulses.c
    src/lib/opus-1.2.1/decoder_set_fs.c
    src/lib/opus-1.2.1/enc_API.c
    src/lib/opus-1.2.1/encode_frame_FIX.c
    src/lib/opus-1.2.1/encode_indices.c
    src/lib/opus-1.2.1/encode_pulses.c
    src/lib/opus-1.2.1/entcode.c
    src/lib/opus-1.2.1/entdec.c
    src/lib/opus-1.2.1/entenc.c
    src/lib/opus-1.2.1/find_LPC_FIX.c
    src/lib/opus-1.2.1/find_LTP_FIX.c
    src/lib/opus-1.2.1/find_pitch_lags_FIX.c
    src/lib/opus-1.2.1/find_pred_coefs_FIX.c
    src/lib/opus-1.2.1/gain_quant.c
    src/lib/opus-1.2.1/init_decoder.c
    src/lib/opus-1.2.1/init_encoder.c
    src/lib/opus-1.2.1/inner_prod_aligned.c
    src/lib/opus-1.2.1/interpolate.c
    src/lib/opus-1.2.1/k2a_FIX.c
    src/lib/opus-1.2.1/k2a_Q16_FIX.c
    src/lib/opus-1.2.1/kiss_fft.c
    src/lib/opus-1.2.1/laplace.c
    src/lib/opus-1.2.1/lin2log.c
    src/lib/opus-1.2.1/log2lin.c
    src/lib/opus-1.2.1/mathops.c
    src/lib/opus-1.2.1/mdct.c
    src/lib/opus-1.2.1/mlp.c
    src/lib/opus-1.2.1/mlp_data.c
    src/lib/opus-1.2.1/modes.c
    src/lib/opus-1.2.1/noise_shape_analysis_FIX.c
    src/lib/opus-1.2.1/opus.c
    src/lib/opus-1.2.1/opus_decoder.c
    src/lib/opus-1.2.1/opus_encoder.c
    src/lib/opus-1.2.1/opus_multistream.c
    src/lib/opus-1.2.1/opus_multistream_decoder.c
    src/lib/opus-1.2.1/opus_multistream_encoder.c
    src/lib/opus-1.2.1/pitch.c
    src/lib/opus-1.2.1/pitch_analysis_core_FIX.c
    src/lib/opus-1.2.1/pitch_est_tables.c
    src/lib/opus-1.2.1/process_NLSFs.c
    src/lib/opus-1.2.1/process_gains_FIX.c
    src/lib/opus-1.2.1/quant_LTP_gains.c
    src/lib/opus-1.2.1/quant_bands.c
    src/lib/opus-1.2.1/rate.c
    src/lib/opus-1.2.1/regularize_correlations_FIX.c
    src/lib/opus-1.2.1/repacketizer.c
    src/lib/opus-1.2.1/resampler.c
    src/lib/opus-1.2.1/resampler_down2.c
    src/lib/opus-1.2.1/resampler_down2_3.c
    src/lib/opus-1.2.1/resampler_private_AR2.c
    src/lib/opus-1.2.1/resampler_private_IIR_FIR.c
    src/lib/opus-1.2.1/resampler_private_down_FIR.c
    src/lib/opus-1.2.1/resampler_private_up2_HQ.c
    src/lib/opus-1.2.1/resampler_rom.c
    src/lib/opus-1.2.1/residual_energy16_FIX.c
    src/lib/opus-1.2.1/residual_energy_FIX.c
    src/lib/opus-1.2.1/schur64_FIX.c
    src/lib/opus-1.2.1/schur_FIX.c
    src/lib/opus-1.2.1/shell_coder.c
    src/lib/opus-1.2.1/sigm_Q15.c
    src/lib/opus-1.2.1/sort.c
    src/lib/opus-1.2.1/stereo_LR_to_MS.c
    src/lib/opus-1.2.1/stereo_MS_to_LR.c
    src/lib/opus-1.2.1/stereo_decode_pred.c
    src/lib/opus-1.2.1/stereo_encode_pred.c
    src/lib/opus-1.2.1/stereo_find_predictor.c
    src/lib/opus-1.2.1/stereo_quant_pred.c
    src/lib/opus-1.2.1/sum_sqr_shift.c
    src/lib/opus-1.2.1/table_LSF_cos.c
    src/lib/opus-1.2.1/tables_LTP.c
    src/lib/opus-1.2.1/tables_NLSF_CB_NB_MB.c
    src/lib/opus-1.2.1/tables_NLSF_CB_WB.c
    src/lib/opus-1.2.1/tables_gain.c
    src/lib/opus-1.2.1/tables_other.c
    src/lib/opus-1.2.1/tables_pitch_lag.c
    src/lib/opus-1.2.1/tables_pulses_per_block.c
    src/lib/opus-1.2.1/vector_ops_FIX.c
    src/lib/opus-1.2.1/vq.c
    src/lib/opus-1.2.1/warped_autocorrelation_FIX.c
    src/lib/opus-1.2.1/arm/celt_pitch_xcorr_arm_gcc.s
)

set(CMAKE_C_FLAGS "${CMAKE_C_FLAGS} -DARM_MATH_CM4")
# set(CMAKE_C_FLAGS "${CMAKE_C_FLAGS} -DVAR_ARRAYS")
set(CMAKE_C_FLAGS "${CMAKE_C_FLAGS} -DOPUS_ARM_ASM")
set(CMAKE_C_FLAGS "${CMAKE_C_FLAGS} -DOPUS_ARM_INLINE_ASM")
set(CMAKE_C_FLAGS "${CMAKE_C_FLAGS} -DOPUS_ARM_INLINE_EDSP")
set(CMAKE_C_FLAGS "${CMAKE_C_FLAGS} -DOPUS_ARM_INLINE_MEDIA")
set(CMAKE_C_FLAGS "${CMAKE_C_FLAGS} -DOPUS_ARM_MAY_HAVE_EDSP")
set(CMAKE_C_FLAGS "${CMAKE_C_FLAGS} -DOPUS_ARM_PRESUME_EDSP")
set(CMAKE_C_FLAGS "${CMAKE_C_FLAGS} -DOPUS_BUILD")
set(CMAKE_C_FLAGS "${CMAKE_C_FLAGS} -DUSE_ALLOCA")
set(CMAKE_C_FLAGS "${CMAKE_C_FLAGS} -DFIXED_POINT -DDISABLE_FLOAT_API")
set(CMAKE_C_FLAGS "${CMAKE_C_FLAGS} -DHAVE_CONFIG_H")
set(CMAKE_C_FLAGS "${CMAKE_C_FLAGS} -DHAVE_ALLOCA_H")
set(CMAKE_C_FLAGS "${CMAKE_C_FLAGS} -fsingle-precision-constant") # A lot of constants are written as doubles
set(CMAKE_C_FLAGS "${CMAKE_C_FLAGS} -DHAVE_LRINT -DHAVE_LRINTF")

# Explicit laboratory image only; never enabled in field.conf.
option(LISTENER_QUEUE_FAULT_TEST "Inject 3s and 8s sender stalls for hardware validation" OFF)
if(LISTENER_QUEUE_FAULT_TEST)
    target_compile_definitions(app PRIVATE LISTENER_QUEUE_FAULT_TEST=1)
    target_sources(app PRIVATE tests/transport_fault_injection.c)
    zephyr_link_libraries(-Wl,--wrap=bt_gatt_notify_cb)
endif()
```

## prj.conf
```kconfig
#
# Hardware settings
#

CONFIG_GPIO=y
CONFIG_NRFX_PDM=y
CONFIG_ADC=y

# To flash via dev board
#CONFIG_BUILD_OUTPUT_UF2=n
#CONFIG_USE_DT_CODE_PARTITION=n

#
# Bluetooth settings
#

CONFIG_BT=y
CONFIG_BT_PERIPHERAL=y
CONFIG_BT_DEVICE_NAME="Friend"
CONFIG_BT_MAX_CONN=1
CONFIG_BT_MAX_PAIRED=1
# Continuous audio needs frequent connection events, with enough supervision
# tolerance to recover from a short fade without resetting the audio queue.
CONFIG_BT_PERIPHERAL_PREF_MIN_INT=12
CONFIG_BT_PERIPHERAL_PREF_MAX_INT=24
CONFIG_BT_PERIPHERAL_PREF_LATENCY=0
CONFIG_BT_PERIPHERAL_PREF_TIMEOUT=400
CONFIG_BT_DEVICE_APPEARANCE=22
CONFIG_BT_GATT_DYNAMIC_DB=y

# CONFIG_BT_L2CAP_DYNAMIC_CHANNEL=y
# CONFIG_BT_SMP=y
# CONFIG_BT_LL_SW_SPLIT=y # Alternative implementation

# Battery and Device Information services
CONFIG_BT_BAS=y
CONFIG_BT_DIS=y
CONFIG_BT_DIS_PNP=n
CONFIG_BT_DIS_MODEL="Friend"
CONFIG_BT_DIS_MANUF="Based Hardware"
CONFIG_BT_DIS_FW_REV=y
CONFIG_BT_DIS_HW_REV=y
CONFIG_BT_DIS_FW_REV_STR="1.0.4"
CONFIG_BT_DIS_HW_REV_STR="Seeed Xiao BLE Sense"

# Large packets
CONFIG_BT_L2CAP_TX_MTU=498
CONFIG_BT_L2CAP_TX_BUF_COUNT=10
# Keep multiple audio notifications ready across 30–45 ms connection events.
# Three default credits can cap throughput below the 100 frames/s capture rate.
CONFIG_BT_ATT_TX_COUNT=12
CONFIG_BT_BUF_ACL_TX_COUNT=12
CONFIG_BT_CONN_TX_MAX=30
CONFIG_BT_BUF_ACL_RX_SIZE=2048
# The host fragments larger ATT PDUs; 251 matches the controller data length
# without reserving 2048 bytes for each transmit credit.
CONFIG_BT_BUF_ACL_TX_SIZE=251
CONFIG_BT_CTLR_DATA_LENGTH_MAX=251

CONFIG_BT_USER_DATA_LEN_UPDATE=y
CONFIG_BT_AUTO_DATA_LEN_UPDATE=y
CONFIG_BT_USER_PHY_UPDATE=y
CONFIG_BT_AUTO_PHY_UPDATE=y

# Codecs
# CONFIG_LIBLC3=y

# Debug
# CONFIG_DEBUG=y
# CONFIG_ASSERT=y
# CONFIG_LOG=y
# CONFIG_LOG_PRINTK=y
# CONFIG_LOG_BUFFER_SIZE=4096
# CONFIG_LOG_PROCESS_THREAD_STACK_SIZE=4096
# CONFIG_LOG_MODE_IMMEDIATE=y

# Log Levels
# CONFIG_BT_DEBUG_LOG=y
# CONFIG_BT_L2CAP_LOG_LEVEL_DBG=y
# CONFIG_BT_LOG_LEVEL_DBG=y

# CONFIG_LOG_PROCESS_THREAD_STACK_SIZE=4096
# CONFIG_BT_RX_STACK_SIZE=4096
# CONFIG_BT_CTLR_RX_PRIO_STACK_SIZE=4096
# CONFIG_BT_DEBUG_LOG=y
# CONFIG_LOG_BUFFER_SIZE=32000
# CONFIG_LOG_OVERRIDE_LEVEL=4
# CONFIG_LOG_PROCESS_THREAD_STACK_SIZE=4096
# CONFIG_BT_RX_STACK_SIZE=4096
# CONFIG_BT_CTLR_RX_PRIO_STACK_SIZE=4096

# RTT
# CONFIG_UART_CONSOLE=n
# CONFIG_SEGGER_RTT_BUFFER_SIZE_UP=2048
# CONFIG_RTT_CONSOLE=y
# CONFIG_LOG_BACKEND_RTT=y
CONFIG_CODEC_OPUS=y
```

## field.conf
```kconfig
CONFIG_BT_DIS_FW_REV_STR="1.0.4-queue2"
CONFIG_LOG=y
CONFIG_LOG_DEFAULT_LEVEL=3
CONFIG_LOG_PRINTK=y
CONFIG_LOG_MODE_DEFERRED=y
CONFIG_LOG_BUFFER_SIZE=4096
CONFIG_UART_CONSOLE=y
CONFIG_LOG_BACKEND_UART=y
CONFIG_USB_DEVICE_INITIALIZE_AT_BOOT=y
CONFIG_FLASH=y
CONFIG_FLASH_MAP=y
CONFIG_NVS=y
CONFIG_NVS_DATA_CRC=y
CONFIG_NVS_LOOKUP_CACHE=y
```

## src/main.c
```c
#include <zephyr/kernel.h>
#include "transport.h"
#include "mic.h"
#include "utils.h"
#include "led.h"
#include "config.h"
#include "diagnostics.h"
#include "audio.h"
#include "codec.h"

static void codec_handler(uint8_t *data, size_t len)
{
	if (len == 0) { diagnostics_error(STREAM_CODEC, -EIO); return; }
	diagnostics_progress(STREAM_CODEC);
	broadcast_audio_packets(data, len); // Errors are logged inside
}

static void mic_handler(int16_t *buffer)
{
	diagnostics_progress(STREAM_MIC);
	int err = codec_receive_pcm(buffer, MIC_BUFFER_SAMPLES);
	if (err) { diagnostics_error(STREAM_CODEC, err); }
}

void bt_ctlr_assert_handle(char *name, int type)
{
	diagnostics_error(STREAM_BLE, -EFAULT);
	if (name != NULL)
	{
		printk("Bt assert-> %s", name);
	}
}

bool is_connected = false;
bool is_charging = false;

void set_led_state()
{
	// Recording and connected state - BLUE
	if (is_connected && !diagnostics_has_fault())
	{
		set_led_red(false);
		set_led_green(false);
		set_led_blue(true);
		return;
	}

	// Recording but lost connection - RED
	if (!is_connected || diagnostics_has_fault())
	{
		set_led_red(true);
		set_led_green(false);
		set_led_blue(false);
		return;
	}

	// Not recording, but charging - WHITE
	if (is_charging)
	{
		set_led_red(true);
		set_led_green(true);
		set_led_blue(true);
		return;
	}

	// Not recording - OFF
	set_led_red(false);
	set_led_green(false);
	set_led_blue(false);
}

// Main loop
int main(void)
{
	uint32_t reason = NRF_POWER->RESETREAS;
	diagnostics_init(reason);
	NRF_POWER->RESETREAS = reason;
	printk("Boot reset reason=0x%08x\n", reason);
	// Led start
	ASSERT_OK(led_start());
	set_led_blue(true);

	// Transport start
	ASSERT_OK(transport_start());

	// Codec start
	set_codec_callback(codec_handler);
	ASSERT_OK(codec_start());

	// Mic start
	set_mic_callback(mic_handler);
	ASSERT_OK(mic_start());

	while (1)
	{
		diagnostics_poll(true);
		set_led_state();
		k_msleep(500);
	}

	// Unreachable
	return 0;
}
```

## src/audio_queue.c
```c
#include "audio_queue.h"
#include <string.h>

void audio_queue_reset(struct audio_queue *q)
{
    q->read = q->write = q->used = 0;
}

static void put(struct audio_queue *q, const uint8_t *data, size_t size)
{
    size_t first = size < AUDIO_TX_QUEUE_BYTES - q->write ? size : AUDIO_TX_QUEUE_BYTES - q->write;
    memcpy(q->data + q->write, data, first);
    memcpy(q->data, data + first, size - first);
    q->write = (q->write + size) % AUDIO_TX_QUEUE_BYTES;
    q->used += size;
}

static void get(struct audio_queue *q, uint8_t *data, size_t size)
{
    size_t first = size < AUDIO_TX_QUEUE_BYTES - q->read ? size : AUDIO_TX_QUEUE_BYTES - q->read;
    memcpy(data, q->data + q->read, first);
    memcpy(data + first, q->data, size - first);
    q->read = (q->read + size) % AUDIO_TX_QUEUE_BYTES;
    q->used -= size;
}

bool audio_queue_put(struct audio_queue *q, const uint8_t *data, size_t size, uint16_t sequence)
{
    if (!size || size > AUDIO_TX_FRAME_MAX || size + 4 > AUDIO_TX_QUEUE_BYTES - q->used) {
        return false; /* No partial frame is ever published. */
    }
    uint8_t header[4] = {size & 255, size >> 8, sequence & 255, sequence >> 8};
    put(q, header, sizeof(header));
    put(q, data, size);
    return true;
}

bool audio_queue_get(struct audio_queue *q, struct audio_frame *frame)
{
    if (!q->used) return false;
    uint8_t header[4];
    get(q, header, sizeof(header));
    frame->size = header[0] | ((uint16_t)header[1] << 8);
    frame->sequence = header[2] | ((uint16_t)header[3] << 8);
    get(q, frame->data, frame->size);
    return true;
}
```

## src/audio_queue.h
```c
#pragma once
#include <stdbool.h>
#include <stddef.h>
#include <stdint.h>

/* About five seconds at 32 kbps, including packet headers. Caller serializes
 * access; neither producer nor consumer waits while holding the queue lock. */
#define AUDIO_TX_QUEUE_BYTES 24576
#define AUDIO_TX_FRAME_MAX 320
struct audio_frame {
    uint16_t sequence;
    uint16_t size;
    uint8_t data[AUDIO_TX_FRAME_MAX];
};
struct audio_queue {
    uint8_t data[AUDIO_TX_QUEUE_BYTES];
    size_t read, write, used;
};
void audio_queue_reset(struct audio_queue *q);
bool audio_queue_put(struct audio_queue *q, const uint8_t *data, size_t size, uint16_t sequence);
bool audio_queue_get(struct audio_queue *q, struct audio_frame *frame);
```

## src/codec.c
```c
#include <zephyr/sys/ring_buffer.h>
#include "codec.h"
#include "audio.h"
#include "config.h"
#include "utils.h"
#ifdef CODEC_OPUS
#include "lib/opus-1.2.1/opus.h"
#endif

//
// Output
//

static volatile codec_callback _callback = NULL;

void set_codec_callback(codec_callback callback)
{
    _callback = callback;
}

//
// Input
//

uint8_t codec_ring_buffer_data[AUDIO_BUFFER_SAMPLES * 2]; // 2 bytes per sample
struct ring_buf codec_ring_buf;
K_SEM_DEFINE(codec_ready, 0, 1);

int codec_receive_pcm(int16_t *data, size_t len)
{
    if (ring_buf_space_get(&codec_ring_buf) < len * 2) {
        return -1; /* Reject the entire PCM buffer; never splice partial audio. */
    }
    int written = ring_buf_put(&codec_ring_buf, (uint8_t *)data, len * 2);
    if (written != len * 2)
    {

        return -1;
    }
    k_sem_give(&codec_ready);
    return 0;
}

//
// Thread
//

int16_t codec_input_samples[CODEC_PACKAGE_SAMPLES];
uint8_t codec_output_bytes[CODEC_OUTPUT_MAX_BYTES];
K_THREAD_STACK_DEFINE(codec_stack, 32000);
static struct k_thread codec_thread;
uint16_t execute_codec();

#if CODEC_OPUS
#if (CONFIG_OPUS_MODE == CONFIG_OPUS_MODE_CELT)
#define OPUS_ENCODER_SIZE 7180
#endif
#if (CONFIG_OPUS_MODE == CONFIG_OPUS_MODE_HYBRID)
#define OPUS_ENCODER_SIZE 10916
#endif
__ALIGN(4)
static uint8_t m_opus_encoder[OPUS_ENCODER_SIZE];
static OpusEncoder *const m_opus_state = (OpusEncoder *)m_opus_encoder;
#endif

void codec_entry()
{
    uint16_t output_size;
    while (1)
    {

        // Check if we have enough data
        if (ring_buf_size_get(&codec_ring_buf) < CODEC_PACKAGE_SAMPLES * 2)
        {
            k_sem_take(&codec_ready, K_FOREVER);
            continue;
        }

        // Read package
        ring_buf_get(&codec_ring_buf, (uint8_t *)codec_input_samples, CODEC_PACKAGE_SAMPLES * 2);

        // Run Codec
        output_size = execute_codec();

        // Notify
        if (_callback)
        {
            _callback(codec_output_bytes, output_size);
        }

        // Yield
        k_yield();
    }
}

int codec_start()
{
    
// OPUS
#if CODEC_OPUS
    ASSERT_TRUE(opus_encoder_get_size(1) == sizeof(m_opus_encoder));
    ASSERT_TRUE(opus_encoder_init(m_opus_state, 16000, 1, CODEC_OPUS_APPLICATION) == OPUS_OK);
    ASSERT_TRUE(opus_encoder_ctl(m_opus_state, OPUS_SET_BITRATE(CODEC_OPUS_BITRATE)) == OPUS_OK);
    ASSERT_TRUE(opus_encoder_ctl(m_opus_state, OPUS_SET_VBR(CODEC_OPUS_VBR)) == OPUS_OK);
    ASSERT_TRUE(opus_encoder_ctl(m_opus_state, OPUS_SET_VBR_CONSTRAINT(0)) == OPUS_OK);
    ASSERT_TRUE(opus_encoder_ctl(m_opus_state, OPUS_SET_COMPLEXITY(CODEC_OPUS_COMPLEXITY)) == OPUS_OK);
    ASSERT_TRUE(opus_encoder_ctl(m_opus_state, OPUS_SET_SIGNAL(OPUS_SIGNAL_VOICE)) == OPUS_OK);
    ASSERT_TRUE(opus_encoder_ctl(m_opus_state, OPUS_SET_LSB_DEPTH(16)) == OPUS_OK);
    ASSERT_TRUE(opus_encoder_ctl(m_opus_state, OPUS_SET_DTX(0)) == OPUS_OK);
    ASSERT_TRUE(opus_encoder_ctl(m_opus_state, OPUS_SET_INBAND_FEC(0)) == OPUS_OK);
    ASSERT_TRUE(opus_encoder_ctl(m_opus_state, OPUS_SET_PACKET_LOSS_PERC(0)) == OPUS_OK);
#endif

    // Thread
    ring_buf_init(&codec_ring_buf, sizeof(codec_ring_buffer_data), codec_ring_buffer_data);
    k_thread_create(&codec_thread, codec_stack, K_THREAD_STACK_SIZEOF(codec_stack), (k_thread_entry_t)codec_entry, NULL, NULL, NULL, K_PRIO_PREEMPT(4), 0, K_NO_WAIT);

    // Success
    return 0;
}

//
// MU-Law codec
//

#if CODEC_MU_LAW

uint16_t execute_codec()
{
    for (int i = 0; i < CODEC_PACKAGE_SAMPLES / CODEC_DIVIDER; i++)
    {
        codec_output_bytes[i] = linear2ulaw(codec_input_samples[i * CODEC_DIVIDER]);
    }
    return CODEC_PACKAGE_SAMPLES / CODEC_DIVIDER;
}

#endif

//
// PCM codec
//

#if CODEC_PCM

uint16_t execute_codec()
{
    for (int i = 0; i < CODEC_PACKAGE_SAMPLES / CODEC_DIVIDER; i++)
    {
        codec_output_bytes[i * 2] = codec_input_samples[i * CODEC_DIVIDER] & 0xFF;
        codec_output_bytes[i * 2 + 1] = (codec_input_samples[i * CODEC_DIVIDER] >> 8) & 0xFF;
    }
    return (CODEC_PACKAGE_SAMPLES / CODEC_DIVIDER) * 2;
}
#endif

//
// Opus codec
//

#if CODEC_OPUS

uint16_t execute_codec()
{
    opus_int32 size = opus_encode(m_opus_state, codec_input_samples, CODEC_PACKAGE_SAMPLES, codec_output_bytes, sizeof(codec_output_bytes));
    if (size < 0)
    {
        printk("Opus encoding failed: %d\n", size);
        return 0;
    }
    // printk("Opus encoding success: %i\n", size);
    return size;
}

#endif
```

## src/diagnostics.c
```c
#include "diagnostics.h"
#include "field_journal.h"

#include <zephyr/bluetooth/gatt.h>
#include <zephyr/bluetooth/uuid.h>
#include <zephyr/kernel.h>
#include <zephyr/logging/log.h>
#include <zephyr/sys/byteorder.h>

LOG_MODULE_REGISTER(diagnostics, CONFIG_LOG_DEFAULT_LEVEL);

static struct stream_health health;
static struct k_spinlock health_lock;
static uint8_t snapshot[STREAM_HEALTH_WIRE_SIZE];
static const uint8_t *journal_snapshot;
static uint16_t journal_page;

static ssize_t read_journal(struct bt_conn *conn, const struct bt_gatt_attr *attr,
                            void *buf, uint16_t len, uint16_t offset)
{
    if (!journal_snapshot) return BT_GATT_ERR(BT_ATT_ERR_UNLIKELY);
    size_t start = (size_t)journal_page * 512U;
    size_t size = MIN(512U, JOURNAL_WIRE_SIZE - start);
    return bt_gatt_attr_read(conn, attr, buf, len, offset, journal_snapshot + start, size);
}

static ssize_t select_journal_page(struct bt_conn *conn, const struct bt_gatt_attr *attr,
                                   const void *buf, uint16_t len, uint16_t offset, uint8_t flags)
{
    ARG_UNUSED(conn); ARG_UNUSED(attr); ARG_UNUSED(flags);
    if (offset) return BT_GATT_ERR(BT_ATT_ERR_INVALID_OFFSET);
    if (len != 2) return BT_GATT_ERR(BT_ATT_ERR_INVALID_ATTRIBUTE_LEN);
    uint16_t page = sys_get_le16(buf);
    if ((size_t)page * 512U >= JOURNAL_WIRE_SIZE) return BT_GATT_ERR(BT_ATT_ERR_VALUE_NOT_ALLOWED);
    if (page == 0) journal_snapshot = field_journal_snapshot();
    if (!journal_snapshot) return BT_GATT_ERR(BT_ATT_ERR_UNLIKELY);
    journal_page = page;
    return len;
}

static ssize_t
read_diagnostics(struct bt_conn *conn, const struct bt_gatt_attr *attr, void *buf, uint16_t len, uint16_t offset)
{
    /* BT_MAX_CONN=1. Freeze the complete snapshot for the ensuing Read Blob
     * requests instead of returning a different event ring at each offset.
     */
    if (offset == 0) {
        k_spinlock_key_t key = k_spin_lock(&health_lock);
        stream_health_encode(&health, k_uptime_get_32(), snapshot);
        k_spin_unlock(&health_lock, key);
    }
    return bt_gatt_attr_read(conn, attr, buf, len, offset, snapshot, sizeof(snapshot));
}

static struct bt_uuid_128 diagnostics_uuid =
    BT_UUID_INIT_128(BT_UUID_128_ENCODE(0xC7C70000, 0x6E8D, 0x4C34, 0xB792, 0xB7D0F7C3A981));
static struct bt_uuid_128 snapshot_uuid =
    BT_UUID_INIT_128(BT_UUID_128_ENCODE(0xC7C70001, 0x6E8D, 0x4C34, 0xB792, 0xB7D0F7C3A981));
static struct bt_uuid_128 journal_uuid =
    BT_UUID_INIT_128(BT_UUID_128_ENCODE(0xC7C70002, 0x6E8D, 0x4C34, 0xB792, 0xB7D0F7C3A981));
static struct bt_uuid_128 journal_page_uuid =
    BT_UUID_INIT_128(BT_UUID_128_ENCODE(0xC7C70003, 0x6E8D, 0x4C34, 0xB792, 0xB7D0F7C3A981));

BT_GATT_SERVICE_DEFINE(
    stream_diagnostics,
    BT_GATT_PRIMARY_SERVICE(&diagnostics_uuid),
    BT_GATT_CHARACTERISTIC(&snapshot_uuid.uuid, BT_GATT_CHRC_READ, BT_GATT_PERM_READ, read_diagnostics, NULL, NULL),
    BT_GATT_CHARACTERISTIC(&journal_uuid.uuid, BT_GATT_CHRC_READ, BT_GATT_PERM_READ, read_journal, NULL, NULL),
    BT_GATT_CHARACTERISTIC(&journal_page_uuid.uuid, BT_GATT_CHRC_WRITE, BT_GATT_PERM_WRITE, NULL, select_journal_page, NULL));

void diagnostics_init(uint32_t reset_reason)
{
    field_journal_init(reset_reason);
    k_spinlock_key_t key = k_spin_lock(&health_lock);
    stream_health_init(&health, reset_reason);
    field_journal_capture(&health, k_uptime_get_32(), JOURNAL_BOOT, 0xff, reset_reason);
    k_spin_unlock(&health_lock, key);
}

void diagnostics_connection(bool connected, uint8_t reason)
{
    k_spinlock_key_t key = k_spin_lock(&health_lock);
    stream_health_connection(&health, k_uptime_get_32(), connected, reason);
    field_journal_capture(&health, k_uptime_get_32(), connected ? STREAM_CONNECTED : STREAM_DISCONNECTED, 0xff, reason);
    k_spin_unlock(&health_lock, key);
}

void diagnostics_subscription(bool subscribed)
{
    k_spinlock_key_t key = k_spin_lock(&health_lock);
    stream_health_subscription(&health, k_uptime_get_32(), subscribed);
    field_journal_capture(&health, k_uptime_get_32(), STREAM_SUBSCRIPTION, 0xff, subscribed);
    k_spin_unlock(&health_lock, key);
}

void diagnostics_progress(enum stream_stage stage)
{
    k_spinlock_key_t key = k_spin_lock(&health_lock);
    stream_health_progress(&health, k_uptime_get_32(), stage);
    k_spin_unlock(&health_lock, key);
}

void diagnostics_error(enum stream_stage stage, int error)
{
    k_spinlock_key_t key = k_spin_lock(&health_lock);
    stream_health_error(&health, k_uptime_get_32(), stage, error);
    field_journal_capture(&health, k_uptime_get_32(), STREAM_ERROR, stage, error);
    k_spin_unlock(&health_lock, key);
}

bool diagnostics_has_fault(void)
{
    k_spinlock_key_t key = k_spin_lock(&health_lock);
    bool fault = health.stalled_stage >= 0;
    k_spin_unlock(&health_lock, key);
    return fault;
}

void diagnostics_battery(uint16_t millivolts)
{
    k_spinlock_key_t key = k_spin_lock(&health_lock);
    health.battery_millivolts = millivolts;
    k_spin_unlock(&health_lock, key);
}

void diagnostics_poll(bool expected)
{
    static uint32_t last_report_ms;
    static uint32_t last_checkpoint_ms;
    k_spinlock_key_t key = k_spin_lock(&health_lock);
    uint32_t now = k_uptime_get_32();
    stream_health_expected(&health, now, expected);
    bool changed = stream_health_poll(&health, now);
    int8_t stage = health.stalled_stage;
    int error = stage < 0 ? 0 : health.last_error[stage];
    bool report = now - last_report_ms >= 300000U;
    if (changed) field_journal_capture(&health, now, stage >= 0 ? STREAM_STALLED : STREAM_RESUMED, stage, error);
    if (now - last_checkpoint_ms >= 300000U) {
        last_checkpoint_ms = now;
        field_journal_capture(&health, now, JOURNAL_CHECKPOINT, 0xff, 0);
    }
    uint32_t counts[STREAM_STAGE_COUNT];
    uint32_t ages[STREAM_STAGE_COUNT];
    bool connected = health.connected;
    bool subscribed = health.subscribed;
    uint32_t battery = health.battery_millivolts;
    if (report) {
        last_report_ms = now;
        for (size_t i = 0; i < STREAM_STAGE_COUNT; i++) {
            counts[i] = health.progress_count[i];
            ages[i] = now - health.last_progress[i];
        }
    }
    k_spin_unlock(&health_lock, key);

    if (changed) {
        if (stage >= 0) {
            LOG_ERR(
                "Audio stream stalled: stage=%d last_error=%d threshold_ms=%u", stage, error, STREAM_HEALTH_TIMEOUT_MS);
        } else {
            LOG_INF("Audio stream progress resumed");
        }
    }
    if (report) {
        LOG_INF("Stream health: connected=%d subscribed=%d expected=%d stalled=%d "
                "mic=%u codec=%u queue=%u ble=%u ages_ms=%u/%u/%u/%u battery_mv=%u",
                connected,
                subscribed,
                expected,
                stage,
                counts[0],
                counts[1],
                counts[2],
                counts[3],
                ages[0],
                ages[1],
                ages[2],
                ages[3],
                battery);
    }
}
```

## src/diagnostics.h
```c
#ifndef DIAGNOSTICS_H
#define DIAGNOSTICS_H

#include "stream_health.h"

void diagnostics_init(uint32_t reset_reason);
void diagnostics_connection(bool connected, uint8_t reason);
void diagnostics_subscription(bool subscribed);
void diagnostics_progress(enum stream_stage stage);
void diagnostics_error(enum stream_stage stage, int error);
void diagnostics_battery(uint16_t millivolts);
void diagnostics_poll(bool expected);
bool diagnostics_has_fault(void);

#endif
```

## src/field_journal.c
```c
#include "field_journal.h"

#include <errno.h>
#include <string.h>
#include <zephyr/drivers/flash.h>
#include <zephyr/fs/nvs.h>
#include <zephyr/kernel.h>
#include <zephyr/logging/log.h>
#include <zephyr/storage/flash_map.h>
#include <zephyr/sys/byteorder.h>
#include <zephyr/sys/atomic.h>

LOG_MODULE_REGISTER(field_journal, CONFIG_LOG_DEFAULT_LEVEL);

#define TOTAL_SLOTS (JOURNAL_FAULT_SLOTS + JOURNAL_CHECKPOINT_SLOTS)
#define BOOT_ID_KEY 0x7000U
#define ERROR_REPEAT_MS 3600000U
#define ERROR_CHANGE_MS 60000U

BUILD_ASSERT(FIXED_PARTITION_OFFSET(storage_partition) == 0xec000);
BUILD_ASSERT(FIXED_PARTITION_SIZE(storage_partition) == 0x8000);

struct pending_record { uint8_t data[JOURNAL_RECORD_SIZE]; };
static struct nvs_fs fs;
K_MSGQ_DEFINE(journal_queue, sizeof(struct pending_record), 16, 4);
K_MUTEX_DEFINE(journal_cache_lock);
K_SEM_DEFINE(journal_ready, 0, 1);
static uint8_t records[TOTAL_SLOTS][JOURNAL_RECORD_SIZE];
static uint8_t frozen[JOURNAL_WIRE_SIZE];
static uint32_t sequence, boot_id, fault_next, checkpoint_next;
static atomic_t dropped, write_failures;
static int storage_status = -EAGAIN;
static bool initialized;
static uint32_t last_error_ms[STREAM_STAGE_COUNT];
static int32_t last_error[STREAM_STAGE_COUNT];
static bool error_seen[STREAM_STAGE_COUNT];

static uint16_t slot_key(uint32_t slot) { return 0x100U + slot; }

static void journal_worker(void *a, void *b, void *c)
{
    ARG_UNUSED(a); ARG_UNUSED(b); ARG_UNUSED(c);
    k_sem_take(&journal_ready, K_FOREVER);
    struct pending_record record;
    for (;;) {
        k_msgq_get(&journal_queue, &record, K_FOREVER);
        bool checkpoint = record.data[12] == JOURNAL_CHECKPOINT;
        uint32_t slot = checkpoint ? JOURNAL_FAULT_SLOTS + checkpoint_next : fault_next;
        sys_put_le32(sequence + 1U, record.data);
        ssize_t rc = nvs_write(&fs, slot_key(slot), record.data, sizeof(record.data));
        k_mutex_lock(&journal_cache_lock, K_FOREVER);
        if (rc == sizeof(record.data)) {
            memcpy(records[slot], record.data, sizeof(record.data));
            sequence++;
            if (checkpoint) checkpoint_next = (checkpoint_next + 1U) % JOURNAL_CHECKPOINT_SLOTS;
            else fault_next = (fault_next + 1U) % JOURNAL_FAULT_SLOTS;
            storage_status = 0;
        } else {
            atomic_inc(&write_failures);
            storage_status = rc < 0 ? rc : -EIO;
        }
        k_mutex_unlock(&journal_cache_lock);
        if (rc != sizeof(record.data)) {
            /* No recursive diagnostic event or flash retry loop on failure. */
            LOG_ERR("Persistent journal write failed: %d", (int)rc);
        }
    }
}

/* Lower priority than audio/BT; flash writes never run in their callbacks. */
K_THREAD_DEFINE(journal_thread, 2048, journal_worker, NULL, NULL, NULL, 12, 0, 0);

void field_journal_init(uint32_t reset_reason)
{
    ARG_UNUSED(reset_reason);
    fs.flash_device = FIXED_PARTITION_DEVICE(storage_partition);
    fs.offset = FIXED_PARTITION_OFFSET(storage_partition);
    struct flash_pages_info info;
    if (!device_is_ready(fs.flash_device)) { storage_status = -ENODEV; return; }
    int rc = flash_get_page_info_by_offs(fs.flash_device, fs.offset, &info);
    if (rc) { storage_status = rc; return; }
    fs.sector_size = info.size;
    fs.sector_count = FIXED_PARTITION_SIZE(storage_partition) / fs.sector_size;
    rc = nvs_mount(&fs);
    if (rc) { storage_status = rc; LOG_ERR("Persistent journal mount failed: %d", rc); return; }

    uint32_t last_fault_seq = 0, last_checkpoint_seq = 0;
    for (uint32_t i = 0; i < TOTAL_SLOTS; i++) {
        ssize_t len = nvs_read(&fs, slot_key(i), records[i], JOURNAL_RECORD_SIZE);
        if (len != JOURNAL_RECORD_SIZE) { memset(records[i], 0, JOURNAL_RECORD_SIZE); continue; }
        uint32_t seq = sys_get_le32(records[i]);
        if (seq > sequence) sequence = seq;
        if (i < JOURNAL_FAULT_SLOTS && seq > last_fault_seq) {
            last_fault_seq = seq; fault_next = (i + 1U) % JOURNAL_FAULT_SLOTS;
        } else if (i >= JOURNAL_FAULT_SLOTS && seq > last_checkpoint_seq) {
            last_checkpoint_seq = seq; checkpoint_next = (i + 1U - JOURNAL_FAULT_SLOTS) % JOURNAL_CHECKPOINT_SLOTS;
        }
        uint32_t old_boot = sys_get_le32(records[i] + 4);
        if (old_boot > boot_id) boot_id = old_boot;
    }
    uint32_t saved_boot;
    if (nvs_read(&fs, BOOT_ID_KEY, &saved_boot, sizeof(saved_boot)) == sizeof(saved_boot) && saved_boot > boot_id) boot_id = saved_boot;
    boot_id++;
    rc = nvs_write(&fs, BOOT_ID_KEY, &boot_id, sizeof(boot_id));
    if (rc != sizeof(boot_id)) { storage_status = rc < 0 ? rc : -EIO; return; }
    storage_status = 0;
    initialized = true;
    k_sem_give(&journal_ready);
    LOG_INF("Persistent journal ready: boot=%u sequence=%u flash_bytes=%u", boot_id, sequence,
            (unsigned int)FIXED_PARTITION_SIZE(storage_partition));
}

void field_journal_capture(const struct stream_health *health, uint32_t now,
                           uint8_t type, uint8_t stage, int32_t detail)
{
    if (!initialized) return;
    if (type == STREAM_ERROR && stage < STREAM_STAGE_COUNT) {
        uint32_t interval = last_error[stage] == detail ? ERROR_REPEAT_MS : ERROR_CHANGE_MS;
        if (error_seen[stage] && now - last_error_ms[stage] < interval) return;
        error_seen[stage] = true;
        last_error[stage] = detail;
        last_error_ms[stage] = now;
    }
    struct pending_record record = {0};
    sys_put_le32(boot_id, record.data + 4);
    sys_put_le32(now, record.data + 8);
    record.data[12] = type;
    record.data[13] = stage;
    record.data[14] = (health->connected ? 1U : 0U) | (health->subscribed ? 2U : 0U) | (health->expected ? 4U : 0U);
    record.data[15] = (uint8_t)health->stalled_stage;
    sys_put_le32((uint32_t)detail, record.data + 16);
    sys_put_le32(health->battery_millivolts, record.data + 20);
    for (uint32_t i = 0; i < STREAM_STAGE_COUNT; i++) {
        sys_put_le32(health->progress_count[i], record.data + 24U + i * 4U);
        sys_put_le32(now - health->last_progress[i], record.data + 40U + i * 4U);
    }
    sys_put_le32(health->error_count, record.data + 56);
    sys_put_le32(atomic_get(&dropped), record.data + 60);
    if (k_msgq_put(&journal_queue, &record, K_NO_WAIT)) atomic_inc(&dropped);
}

const uint8_t *field_journal_snapshot(void)
{
    k_mutex_lock(&journal_cache_lock, K_FOREVER);
    memset(frozen, 0, JOURNAL_HEADER_SIZE);
    memcpy(frozen, "LJ01", 4);
    sys_put_le16(1, frozen + 4);
    sys_put_le16(JOURNAL_RECORD_SIZE, frozen + 6);
    sys_put_le16(JOURNAL_FAULT_SLOTS, frozen + 8);
    sys_put_le16(JOURNAL_CHECKPOINT_SLOTS, frozen + 10);
    sys_put_le32(boot_id, frozen + 12);
    sys_put_le32(sequence, frozen + 16);
    sys_put_le32(atomic_get(&dropped), frozen + 20);
    sys_put_le32(atomic_get(&write_failures), frozen + 24);
    sys_put_le32((uint32_t)storage_status, frozen + 28);
    memcpy(frozen + JOURNAL_HEADER_SIZE, records, sizeof(records));
    k_mutex_unlock(&journal_cache_lock);
    return frozen;
}
```

## src/field_journal.h
```c
#ifndef FIELD_JOURNAL_H
#define FIELD_JOURNAL_H

#include "stream_health.h"

#define JOURNAL_FAULT_SLOTS 256U
#define JOURNAL_CHECKPOINT_SLOTS 32U
#define JOURNAL_RECORD_SIZE 64U
#define JOURNAL_HEADER_SIZE 32U
#define JOURNAL_WIRE_SIZE (JOURNAL_HEADER_SIZE + (JOURNAL_FAULT_SLOTS + JOURNAL_CHECKPOINT_SLOTS) * JOURNAL_RECORD_SIZE)
#define JOURNAL_BOOT 8U
#define JOURNAL_CHECKPOINT 9U

void field_journal_init(uint32_t reset_reason);
/* Capture only; never accesses flash and can be called under health_lock. */
void field_journal_capture(const struct stream_health *health, uint32_t now,
                           uint8_t type, uint8_t stage, int32_t detail);
/* Freezes the latest persisted records in a separate BLE Read Blob buffer. */
const uint8_t *field_journal_snapshot(void);

#endif
```
